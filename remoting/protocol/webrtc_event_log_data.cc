// Copyright 2020 The Chromium Authors
// Use of this source code is governed by a BSD-style license that can be
// found in the LICENSE file.

#include "remoting/protocol/webrtc_event_log_data.h"

#include <utility>

#include "base/check_op.h"
#include "base/logging.h"
#include "base/numerics/safe_conversions.h"

namespace remoting::protocol {

WebrtcEventLogData::WebrtcEventLogData() {
  // See the caveat for base::circular_deque::reserve(). Calling reserve() is
  // OK here, since items are never removed until the list reaches its maximum
  // allowed size.
  sections_.reserve(max_sections_);
}

WebrtcEventLogData::~WebrtcEventLogData() = default;

void WebrtcEventLogData::SetMaxSectionSizeForTest(int max_section_size) {
  base::AutoLock lock(lock_);
  CHECK_GT(max_section_size, 0);
  max_section_size_ = max_section_size;
}

void WebrtcEventLogData::SetMaxSectionsForTest(int max_sections) {
  base::AutoLock lock(lock_);
  CHECK_GT(max_sections, 0);
  max_sections_ = max_sections;
  sections_.reserve(max_sections_);
}

base::circular_deque<WebrtcEventLogData::LogSection>
WebrtcEventLogData::TakeLogData() {
  base::AutoLock lock(lock_);
  auto result = std::move(sections_);

  // The |sections_| container is still valid but unspecified. Call
  // ClearLocked() to be certain it is empty (and the correct capacity is
  // reserved).
  ClearLocked();
  return result;
}

void WebrtcEventLogData::Write(std::string_view log_event) {
  base::AutoLock lock(lock_);
  if (log_event.size() > static_cast<size_t>(max_section_size_)) {
    LOG(WARNING) << "Oversized RTC log event: size = " << log_event.size();
  }

  if (NeedNewSection(log_event.size())) {
    CreateNewSection();
  }

  // Append the log_event to the end of the latest section.
  auto& section = sections_.back();
  section.insert(section.end(), log_event.begin(), log_event.end());
}

void WebrtcEventLogData::Clear() {
  base::AutoLock lock(lock_);
  ClearLocked();
}

void WebrtcEventLogData::ClearLocked() {
  sections_.clear();
  sections_.reserve(max_sections_);
}

bool WebrtcEventLogData::NeedNewSection(size_t log_event_size) const {
  if (sections_.empty()) {
    return true;
  }

  // The event log entries are packet headers generated by WebRTC, and it is
  // assumed that the sizes are small enough to prevent integer overflow.
  return sections_.back().size() + log_event_size >
         static_cast<size_t>(max_section_size_);
}

void WebrtcEventLogData::CreateNewSection() {
  if (static_cast<int>(sections_.size()) >= max_sections_) {
    // Recycle oldest section buffer to avoid heap allocation under lock.
    auto section = std::move(sections_.front());
    sections_.pop_front();
    section.clear();
    sections_.push_back(std::move(section));
  } else {
    sections_.emplace_back();
    sections_.back().reserve(max_section_size_);
  }
}

}  // namespace remoting::protocol

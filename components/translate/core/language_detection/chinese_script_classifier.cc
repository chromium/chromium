// Copyright 2017 The Chromium Authors
// Use of this source code is governed by a BSD-style license that can be
// found in the LICENSE file.

#include "components/translate/core/language_detection/chinese_script_classifier.h"

#include <algorithm>
#include <memory>
#include <string>

#include "base/logging.h"
#include "base/strings/string_util.h"
#include "third_party/icu/source/common/unicode/uniset.h"
#include "third_party/icu/source/common/unicode/unistr.h"

namespace translate {

namespace {
// BCP 47 language code representing Chinese in Han Simplified script.
const char kChineseSimplifiedCode[] = "zh-Hans";

// BCP 47 language code representing Chinese in Han Traditional script.
const char kChineseTraditionalCode[] = "zh-Hant";
}  // namespace

ChineseScriptClassifier::ChineseScriptClassifier() {
  // zh-Hans and zh-Hant codepoints extracted from:
  // third_party/icu/source/data/translit/Hans_Hant.txt
  //
  // zh-Hans codepoints to be stored in a UnicodeSet for later reference.
  const std::string& hans_codepoints =
      "[\u4e07\u4e0e\u4e13\u4e1a\u4e1b\u4e1c"
      "\u4e1d\u4e22\u4e24\u4e25\u4e27\u4e2a\u4e2b"
      "\u4e30\u4e34\u4e3a\u4e3d\u4e3e\u4e49\u4e4c\u4e50"
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      "\u9f86\u9f87\u9f88\u9f89\u9f8a\u9f8b\u9f8c\u9f99"
      "\u9f9a\u9f9b\u9f9f]";
  const std::string& hant_codepoints =
      "[\u003b\u4e1f\u4e26\u4e82\u4e99\u4e9e\u4efd\u4f47"
      "\u4f48\u4f54\u4f57\u4f75\u4f86\u4f96\u4fb6"
      "\u4fb7\u4fc1\u4fc2\u4fd4\u4fe0\u4fec\u4ff1\u5000"
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      "\u9f66\u9f67\u9f69\u9f6a\u9f6c\u9f72\u9f76\u9f77"
      "\u9f8d\u9f8e\u9f90\u9f94\u9f95\u9f9c]";

  // Create UnicodeSets for zh-Hans and zh-Hant for later reference.
  UErrorCode status = U_ZERO_ERROR;
  hans_set_ = std::make_unique<icu::UnicodeSet>(
      icu::UnicodeString::fromUTF8(hans_codepoints), status);
  DVLOG(1) << u_errorName(status);
  hant_set_ = std::make_unique<icu::UnicodeSet>(
      icu::UnicodeString::fromUTF8(hant_codepoints), status);
  DVLOG(1) << u_errorName(status);

  // Make these sets immutable. This keeps the class threadsafe and
  // makes certain operations on these sets faster.
  hans_set_->freeze();
  hant_set_->freeze();
}

bool ChineseScriptClassifier::IsInitialized() const {
  return hans_set_ && hant_set_;
}

ChineseScriptClassifier::~ChineseScriptClassifier() {}

std::string ChineseScriptClassifier::Classify(const std::string& input) const {
  // If there was a problem with initialization, return the empty string.
  if (!IsInitialized()) {
    return "";
  }

  // Operate only on first 500 bytes.
  std::string input_subset;
  base::TruncateUTF8ToByteSize(input, 500, &input_subset);

  // Remove whitespace since transliterators may not preserve it.
  std::erase_if(input_subset, base::IsAsciiWhitespace<char>);

  // Convert the input to icu::UnicodeString so we can iterate over codepoints.
  icu::UnicodeString input_codepoints =
      icu::UnicodeString::fromUTF8(input_subset);

  // Count matches between the original input chars and the Hant and Hans
  // versions of the input.
  int hant_count = 0;
  int hans_count = 0;

  for (int index = 0; index < input_codepoints.length(); ++index) {
    const auto codepoint = input_codepoints.charAt(index);
    if (hans_set_->contains(codepoint))
      ++hans_count;
    if (hant_set_->contains(codepoint))
      ++hant_count;
  }
  DVLOG(1) << "Found " << hans_count << " zh-Hans chars in input";
  DVLOG(1) << "Found " << hant_count << " zh-Hant chars in input";

  if (hant_count > hans_count) {
    return kChineseTraditionalCode;
  } else if (hans_count > hant_count) {
    return kChineseSimplifiedCode;
  } else {  // hans_count == hant_count
    // All characters are the same in both scripts. In this case, we return the
    // following code.
    return kChineseSimplifiedCode;
  }
}

}  // namespace translate

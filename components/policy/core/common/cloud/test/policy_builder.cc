// Copyright 2012 The Chromium Authors
// Use of this source code is governed by a BSD-style license that can be
// found in the LICENSE file.

#ifdef UNSAFE_BUFFERS_BUILD
// TODO(crbug.com/40285824): Remove this and convert code to safer constructs.
#pragma allow_unsafe_buffers
#endif

#include "components/policy/core/common/cloud/test/policy_builder.h"

#include "base/base64.h"
#include "base/notreached.h"
#include "build/build_config.h"
#include "build/chromeos_buildflags.h"
#include "components/policy/core/common/cloud/cloud_policy_constants.h"
#include "crypto/signature_creator.h"

namespace em = enterprise_management;

namespace policy {

const uint8_t kVerificationPrivateKey[] = {
    0x30, 0x82, 0x04, 0xbe, 0x02, 0x01, 0x00, 0x30, 0x0d, 0x06, 0x09, 0x2a,
    0x86, 0x48, 0x86, 0xf7, 0x0d, 0x01, 0x01, 0x01, 0x05, 0x00, 0x04, 0x82,
    0x04, 0xa8, 0x30, 0x82, 0x04, 0xa4, 0x02, 0x01, 0x00, 0x02, 0x82, 0x01,
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    0x57, 0x01, 0x2f, 0x06, 0x26, 0x19};

namespace {

// Signing key test data in DER-encoded PKCS8 format.
const uint8_t kSigningKey[] = {
    0x30, 0x82, 0x01, 0x55, 0x02, 0x01, 0x00, 0x30, 0x0d, 0x06, 0x09, 0x2a,
    0x86, 0x48, 0x86, 0xf7, 0x0d, 0x01, 0x01, 0x01, 0x05, 0x00, 0x04, 0x82,
    0x01, 0x3f, 0x30, 0x82, 0x01, 0x3b, 0x02, 0x01, 0x00, 0x02, 0x41, 0x00,
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    0x98, 0x68, 0xe1, 0x04, 0xa8, 0x92, 0xd0, 0x10, 0xaa,
};

// SHA256 signature of kSigningKey for "example.com" domain.
const uint8_t kSigningKeySignature[] = {
    0x54, 0x20, 0x93, 0x27, 0x2e, 0x7e, 0xae, 0xd5, 0xe5, 0x0f, 0x22, 0x56,
    0x09, 0x0b, 0x38, 0x40, 0x05, 0x0f, 0x25, 0x80, 0xbe, 0xd8, 0xe4, 0x9e,
    0xf0, 0x54, 0xca, 0xc8, 0x04, 0x72, 0x66, 0xcd, 0x1d, 0x6a, 0xb1, 0x04,
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    0xe4, 0x87, 0x95, 0x5d};

// SHA256 signature of kSigningKey for "gmail.com" domain when the testing
// verification key is used.
const uint8_t kSigningKeySignatureForChild[] = {
    0x09, 0xb9, 0x96, 0x69, 0x79, 0xa6, 0xd7, 0x3c, 0x27, 0xdc, 0x47, 0x2b,
    0x75, 0x85, 0x01, 0x2f, 0x75, 0xa5, 0x4d, 0xed, 0x1d, 0xde, 0x9e, 0xae,
    0xfd, 0x45, 0xbf, 0x5e, 0x25, 0xca, 0xe2, 0x0c, 0x77, 0x10, 0x7d, 0x51,
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    0x05, 0xcd, 0x42, 0x85};

// New signing key test data in DER-encoded PKCS8 format.
const uint8_t kNewSigningKey[] = {
    0x30, 0x82, 0x01, 0x54, 0x02, 0x01, 0x00, 0x30, 0x0d, 0x06, 0x09, 0x2a,
    0x86, 0x48, 0x86, 0xf7, 0x0d, 0x01, 0x01, 0x01, 0x05, 0x00, 0x04, 0x82,
    0x01, 0x3e, 0x30, 0x82, 0x01, 0x3a, 0x02, 0x01, 0x00, 0x02, 0x41, 0x00,
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    0x32, 0x1a, 0x6b, 0xb3, 0x5f, 0x35, 0xbd, 0xf3,
};

// SHA256 signature of kNewSigningKey for "example.com" domain.
const uint8_t kNewSigningKeySignature[] = {
    0x66, 0xc0, 0x12, 0xf5, 0x80, 0xe8, 0x6a, 0xe1, 0x94, 0x37, 0xed, 0x9b,
    0xf7, 0x8b, 0x35, 0x05, 0x36, 0xad, 0xc8, 0x18, 0x2e, 0x0a, 0x28, 0x13,
    0x32, 0x6b, 0x97, 0xd7, 0x9b, 0x1b, 0xda, 0x28, 0xa0, 0x3b, 0x17, 0xd9,
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    0x6b, 0xa2, 0x5b, 0xf3};

// The public part of the key to be used by CloudPolicyValidator for
// checking the new public key data signature. This is replacement
// for baked in the code |verification_key_| used by the validator.
// Since we have the private part of this key, in kVerificationPrivateKey
// new signatures can be generated that will pass the checks from
// CloudPolicyValidator.
const uint8_t kVerificationPublicKey[] = {
    0x30, 0x82, 0x01, 0x22, 0x30, 0x0d, 0x06, 0x09, 0x2a, 0x86, 0x48, 0x86,
    0xf7, 0x0d, 0x01, 0x01, 0x01, 0x05, 0x00, 0x03, 0x82, 0x01, 0x0f, 0x00,
    0x30, 0x82, 0x01, 0x0a, 0x02, 0x82, 0x01, 0x01, 0x00, 0xb2, 0x68, 0xc7,
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    0x8f, 0x02, 0x03, 0x01, 0x00, 0x01};

// The signature for the new public key verification data corresponding
// to public_key = policy_signing_key, domain = kFakeDomain and
// new_public_key_version = kNewPublicKeyVersion blob that is signed with
// kVerificationPublicKey.
const uint8_t kPublicKeyVerificationDataSignature[] = {
    0x92, 0x70, 0xb0, 0x64, 0x44, 0x88, 0x9c, 0x3d, 0x51, 0x32, 0xc1, 0x62,
    0x1f, 0x74, 0xff, 0x3f, 0x6f, 0x1a, 0x6d, 0x56, 0x33, 0xbe, 0x4e, 0xd6,
    0x4e, 0xf0, 0x14, 0xd8, 0x21, 0xf5, 0x77, 0x89, 0x54, 0x56, 0x49, 0xbd,
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    0x23, 0x23, 0xde, 0xe1};

// The version of new public key for verification data
const int32_t kNewPublicKeyVersion = 1;

const char user_affiliation_id1[] = "id1";
const char user_affiliation_id2[] = "id2";

std::vector<uint8_t> ExportPublicKey(const crypto::RSAPrivateKey& key) {
  std::vector<uint8_t> public_key;
  CHECK(key.ExportPublicKey(&public_key));
  return public_key;
}

std::string ConvertPublicKeyToString(const std::vector<uint8_t>& public_key) {
  return std::string(reinterpret_cast<const char*>(public_key.data()),
                     public_key.size());
}

// Produces |key|'s signature over |data| and stores it in |signature|.
void SignData(const std::string& data,
              crypto::RSAPrivateKey* const key,
              std::string* const signature,
              em::PolicyFetchRequest::SignatureType signature_type) {
  crypto::SignatureCreator::HashAlgorithm algorithm;
  switch (signature_type) {
    case em::PolicyFetchRequest::SHA1_RSA:
      algorithm = crypto::SignatureCreator::SHA1;
      break;
    case em::PolicyFetchRequest::SHA256_RSA:
      algorithm = crypto::SignatureCreator::SHA256;
      break;
    default:
      // `em::PolicyFetchRequest::NONE` indicates unsigned blobs.
      // Crash is OK here.
      NOTREACHED();
  }

  std::unique_ptr<crypto::SignatureCreator> signature_creator(
      crypto::SignatureCreator::Create(key, algorithm));
  signature_creator->Update(reinterpret_cast<const uint8_t*>(data.c_str()),
                            data.size());
  std::vector<uint8_t> signature_bytes;
  CHECK(signature_creator->Final(&signature_bytes));
  signature->assign(reinterpret_cast<const char*>(signature_bytes.data()),
                    signature_bytes.size());
}

}  // namespace

// Constants used as dummy data for filling the PolicyData protobuf.
// LINT.IfChange
const char PolicyBuilder::kFakeGaiaId[] = "0000111111";
const char PolicyBuilder::kFakeUsername[] = "username@example.com";
// LINT.ThenChange(/chrome/test/base/fake_gaia_mixin.cc)

const char PolicyBuilder::kFakeDeviceId[] = "device-id";
const char PolicyBuilder::kFakeDomain[] = "example.com";
const char PolicyBuilder::kFakeMachineName[] = "machine-name";
const char PolicyBuilder::kFakePolicyType[] = "policy type";
const int PolicyBuilder::kFakePublicKeyVersion = 17;
const int64_t PolicyBuilder::kFakeTimestamp = 365LL * 24 * 60 * 60 * 1000;
const char PolicyBuilder::kFakeToken[] = "token";
const char PolicyBuilder::kFakeServiceAccountIdentity[] = "robot4test@g.com";

PolicyBuilder::PolicyBuilder() {
  SetDefaultSigningKey();
  CreatePolicyData();
  policy_data_->set_policy_type(kFakePolicyType);
  policy_data_->set_timestamp(kFakeTimestamp);
  policy_data_->set_gaia_id(kFakeGaiaId);
  policy_data_->set_request_token(kFakeToken);
  policy_data_->set_machine_name(kFakeMachineName);
  policy_data_->set_public_key_version(kFakePublicKeyVersion);
  policy_data_->set_username(kFakeUsername);
  policy_data_->set_device_id(kFakeDeviceId);
  policy_data_->set_state(em::PolicyData::ACTIVE);
  policy_data_->set_service_account_identity(kFakeServiceAccountIdentity);
  policy_data_->add_user_affiliation_ids(user_affiliation_id1);
  policy_data_->add_user_affiliation_ids(user_affiliation_id2);
}

PolicyBuilder::~PolicyBuilder() = default;

std::unique_ptr<crypto::RSAPrivateKey> PolicyBuilder::GetSigningKey() const {
  if (raw_signing_key_.empty())
    return nullptr;
  return crypto::RSAPrivateKey::CreateFromPrivateKeyInfo(raw_signing_key_);
}

void PolicyBuilder::SetSigningKey(const crypto::RSAPrivateKey& key) {
  key.ExportPrivateKey(&raw_signing_key_);
}

void PolicyBuilder::SetDefaultSigningKey() {
  raw_signing_key_.assign(kSigningKey, kSigningKey + std::size(kSigningKey));
}

void PolicyBuilder::UnsetSigningKey() {
  raw_signing_key_.clear();
}

std::unique_ptr<crypto::RSAPrivateKey> PolicyBuilder::GetNewSigningKey() const {
  if (raw_new_signing_key_.empty())
    return nullptr;
  return crypto::RSAPrivateKey::CreateFromPrivateKeyInfo(raw_new_signing_key_);
}

void PolicyBuilder::SetDefaultNewSigningKey() {
  raw_new_signing_key_.assign(kNewSigningKey,
                              kNewSigningKey + std::size(kNewSigningKey));
  raw_new_signing_key_signature_ = GetTestOtherSigningKeySignature();
}

void PolicyBuilder::UnsetNewSigningKey() {
  raw_new_signing_key_.clear();
  raw_new_signing_key_signature_.clear();
}

void PolicyBuilder::SetDefaultInitialSigningKey() {
  raw_new_signing_key_.assign(kSigningKey,
                              kSigningKey + std::size(kSigningKey));
  raw_new_signing_key_signature_ = GetTestSigningKeySignature();
  UnsetSigningKey();
}

void PolicyBuilder::Build() {
  // Start with a clean state.
  policy_.clear_policy_data();
  policy_.clear_policy_data_signature();

  if (!policy_data_) {
    return;
  }

  // Serialize the policy data.
  CHECK(policy_data_->SerializeToString(policy_.mutable_policy_data()));

  // Signature type of `NONE` indicates an unsigned blob.
  if (signature_type_ == em::PolicyFetchRequest::NONE) {
    return;
  }

  // Rotate/install keys.
  std::unique_ptr<crypto::RSAPrivateKey> new_signing_key = GetNewSigningKey();
  std::unique_ptr<crypto::RSAPrivateKey> current_signing_key = GetSigningKey();
  crypto::RSAPrivateKey* key_to_sign_policy_data_with = nullptr;
  if (new_signing_key) {
    // Add the new public key.
    policy_.set_new_public_key(
        ConvertPublicKeyToString(ExportPublicKey(*new_signing_key)));
    policy_.set_new_public_key_verification_signature_deprecated(
        raw_new_signing_key_signature_);

    // Add the new public key verification data.
    em::PublicKeyVerificationData new_signing_key_verification_data;

    // Need to set as public key the key that will be used to validate the
    // policy. So, it's the new public key.
    new_signing_key_verification_data.set_new_public_key(
        ConvertPublicKeyToString(ExportPublicKey(*new_signing_key)));
    new_signing_key_verification_data.set_domain(kFakeDomain);
    new_signing_key_verification_data.set_new_public_key_version(
        kNewPublicKeyVersion);
    std::string new_signing_key_verification_data_as_string;
    CHECK(new_signing_key_verification_data.SerializeToString(
        &new_signing_key_verification_data_as_string));

    // Note that protobuf serialization doesn't guarantee the same output,
    // but the alternative of putting a hard-coded string here will make
    // the code less clear to read. So, we prefer to use this option with
    // the risk that in the future the signature given by this file will
    // fail.
    policy_.set_new_public_key_verification_data(
        new_signing_key_verification_data_as_string);
    std::string new_signing_key_verification_data_signature =
        GetPublicKeyVerificationDataSignature();
    policy_.set_new_public_key_verification_data_signature(
        new_signing_key_verification_data_signature);

    // The new public key must be signed by the current key in the event of key
    // rotation.
    if (current_signing_key) {
      SignData(policy_.new_public_key(), current_signing_key.get(),
               policy_.mutable_new_public_key_signature(), signature_type_);
    }

    key_to_sign_policy_data_with = new_signing_key.get();
  } else {
    // No new signing key, so clear the old public key (this allows us to
    // reuse the same PolicyBuilder to build multiple policy blobs).
    policy_.clear_new_public_key();
    policy_.clear_new_public_key_verification_signature_deprecated();
    policy_.clear_new_public_key_signature();
    policy_.clear_new_public_key_verification_data();
    policy_.clear_new_public_key_verification_data_signature();

    if (current_signing_key) {
      key_to_sign_policy_data_with = current_signing_key.get();
    }
  }

  // Sign if possible.
  if (key_to_sign_policy_data_with) {
    SignData(policy_.policy_data(), key_to_sign_policy_data_with,
             policy_.mutable_policy_data_signature(), signature_type_);

    // Generate signatures if applicable.
    policy_.set_policy_data_signature_type(signature_type_);
  } else {
    policy_data_->clear_public_key_version();
  }

  return;
}

std::string PolicyBuilder::GetBlob() const {
  return policy_.SerializeAsString();
}

std::unique_ptr<em::PolicyFetchResponse> PolicyBuilder::GetCopy() const {
  return std::make_unique<em::PolicyFetchResponse>(policy_);
}

// static
std::unique_ptr<crypto::RSAPrivateKey> PolicyBuilder::CreateTestSigningKey() {
  std::vector<uint8_t> raw_signing_key(kSigningKey,
                                       kSigningKey + std::size(kSigningKey));
  return crypto::RSAPrivateKey::CreateFromPrivateKeyInfo(raw_signing_key);
}

// static
std::unique_ptr<crypto::RSAPrivateKey>
PolicyBuilder::CreateTestOtherSigningKey() {
  std::vector<uint8_t> raw_new_signing_key(
      kNewSigningKey, kNewSigningKey + std::size(kNewSigningKey));
  return crypto::RSAPrivateKey::CreateFromPrivateKeyInfo(raw_new_signing_key);
}

// static
std::string PolicyBuilder::GetEncodedPolicyVerificationKey() {
  return base::Base64Encode(
      std::string(reinterpret_cast<const char*>(kVerificationPublicKey),
                  std::size(kVerificationPublicKey)));
}

// static
std::string PolicyBuilder::GetPublicKeyVerificationDataSignature() {
  return std::string(
      reinterpret_cast<const char*>(kPublicKeyVerificationDataSignature),
      std::size(kPublicKeyVerificationDataSignature));
}

// static
std::string PolicyBuilder::GetTestSigningKeySignature() {
  return std::string(reinterpret_cast<const char*>(kSigningKeySignature),
                     std::size(kSigningKeySignature));
}

std::string PolicyBuilder::GetTestSigningKeySignatureForChild() {
  return std::string(
      reinterpret_cast<const char*>(kSigningKeySignatureForChild),
      std::size(kSigningKeySignatureForChild));
}

// static
std::string PolicyBuilder::GetTestOtherSigningKeySignature() {
  return std::string(reinterpret_cast<const char*>(kNewSigningKeySignature),
                     std::size(kNewSigningKeySignature));
}

std::vector<uint8_t> PolicyBuilder::GetPublicSigningKey() const {
  std::unique_ptr<crypto::RSAPrivateKey> key = GetSigningKey();
  if (!key)
    return std::vector<uint8_t>();
  return ExportPublicKey(*key);
}

std::vector<uint8_t> PolicyBuilder::GetPublicNewSigningKey() const {
  std::unique_ptr<crypto::RSAPrivateKey> key = GetNewSigningKey();
  if (!key)
    return std::vector<uint8_t>();
  return ExportPublicKey(*key);
}

// static
std::vector<uint8_t> PolicyBuilder::GetPublicTestKey() {
  return ExportPublicKey(*CreateTestSigningKey());
}

// static
std::vector<uint8_t> PolicyBuilder::GetPublicTestOtherKey() {
  return ExportPublicKey(*CreateTestOtherSigningKey());
}

std::string PolicyBuilder::GetPublicSigningKeyAsString() const {
  return ConvertPublicKeyToString(GetPublicSigningKey());
}

std::string PolicyBuilder::GetPublicNewSigningKeyAsString() const {
  return ConvertPublicKeyToString(GetPublicNewSigningKey());
}

// static
std::string PolicyBuilder::GetPublicTestKeyAsString() {
  return ConvertPublicKeyToString(GetPublicTestKey());
}

// static
std::string PolicyBuilder::GetPublicTestOtherKeyAsString() {
  return ConvertPublicKeyToString(GetPublicTestOtherKey());
}

// static
std::vector<std::string> PolicyBuilder::GetUserAffiliationIds() {
  return {user_affiliation_id1, user_affiliation_id2};
}

// static
AccountId PolicyBuilder::GetFakeAccountIdForTesting() {
  return AccountId::FromUserEmailGaiaId(kFakeUsername, kFakeGaiaId);
}

void PolicyBuilder::SetSignatureType(
    em::PolicyFetchRequest::SignatureType signature_type) {
  signature_type_ = signature_type;
}

template <>
TypedPolicyBuilder<em::CloudPolicySettings>::TypedPolicyBuilder()
    : payload_(new em::CloudPolicySettings()) {
  policy_data().set_policy_type(dm_protocol::kChromeUserPolicyType);
}

// Have the instantiation compiled into the module.
template class TypedPolicyBuilder<em::CloudPolicySettings>;

#if !BUILDFLAG(IS_ANDROID) && !BUILDFLAG(IS_IOS)
template <>
TypedPolicyBuilder<em::ExternalPolicyData>::TypedPolicyBuilder() {
  CreatePayload();
  policy_data().set_policy_type(dm_protocol::kChromeExtensionPolicyType);
}

template class TypedPolicyBuilder<em::ExternalPolicyData>;
#endif

#if BUILDFLAG(IS_CHROMEOS_ASH)
StringPolicyBuilder::StringPolicyBuilder() = default;

void StringPolicyBuilder::Build() {
  policy_data().set_policy_value(payload_);
  PolicyBuilder::Build();
}
#endif

}  // namespace policy

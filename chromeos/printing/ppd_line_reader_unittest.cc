// Copyright 2017 The Chromium Authors. All rights reserved.
// Use of this source code is governed by a BSD-style license that can be
// found in the LICENSE file.

#include "chromeos/printing/ppd_line_reader.h"

#include <memory>
#include <string>
#include <vector>

#include "base/stl_util.h"
#include "base/strings/string_split.h"
#include "testing/gtest/include/gtest/gtest.h"

namespace chromeos {
namespace {

// Test ppd contents.  This is an excerpt from an HPLIP ppd.
const char* kTestPpd = R"PPD(*PPD-Adobe: "4.3"
*%%%% PPD file for HP PSC 900 Series with CUPS.
*%%%% Created by the CUPS PPD Compiler CUPS v1.5.0.
*% (c) 2008 Copyright HP Development Company, LP
*FormatVersion: "4.3"
*FileVersion: "3.17.9"
*LanguageVersion: English
*LanguageEncoding: ISOLatin1
*PCFileName: "hp-psc_900_series.ppd"
*Product: "(HP PSC 900 All-in-one Printer)"
*Manufacturer: "HP"
*ModelName: "HP PSC 900 Series"
*ShortNickName: "HP PSC 900 Series"
*NickName: "HP PSC 900 Series, hpcups 3.17.9"
*PSVersion: "(3010.000) 0"
*LanguageLevel: "3"
*ColorDevice: True
*DefaultColorSpace: RGB
*FileSystem: False
*Throughput: "1"
*LandscapeOrientation: Plus90
*TTRasterizer: Type42
*% Driver-defined attributes...
*RequiresPageRegion All: True
*cupsEvenDuplex: True
*cupsBackSide: "Rotated"
*cupsFlipDuplex: True
*hpPrinterLanguage: "pcl3gui"
*hpPrinterPlatform: "dj970"
*HPMechOffset: "70"
*cupsModelName: "DESKJET 930"
*1284DeviceID: "MFG:HP;MDL:psc 900 series;DES:psc 900 series;"
*cupsVersion: 1.5)PPD";

// This is the exact same contents as kTestPpd, but gzipped
// with gzip --best.
const char kTestPpdGzipped[] = {
    0x1f, 0x8b, 0x08, 0x08, 0xd9, 0x8c, 0xef, 0x59, 0x02, 0x03, 0x70, 0x70,
    0x64, 0x67, 0x7a, 0x69, 0x70, 0x70, 0x65, 0x64, 0x2e, 0x70, 0x70, 0x64,
    0x00, 0x7d, 0x93, 0x51, 0x6f, 0xda, 0x30, 0x10, 0xc7, 0xdf, 0xf9, 0x14,
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    0xad, 0x3f, 0xe6, 0x78, 0x79, 0x4f, 0xd4, 0x03, 0x00, 0x00};

constexpr int kPpdMaxLineLength = 255;

// Read |ppd_contents| line by line with a reader using |max_line_length| as the
// line limit.  Expect the read lines to be the same as |expected_lines|.
void RunTest(const std::string& ppd_contents,
             int max_line_length,
             const std::vector<std::string>& expected_lines) {
  auto reader = PpdLineReader::Create(ppd_contents, max_line_length);
  std::string actual;
  for (const std::string& expected : expected_lines) {
    ASSERT_TRUE(reader->NextLine(&actual));
    EXPECT_EQ(expected, actual);
  }
  EXPECT_FALSE(reader->NextLine(&actual));
}

// Trivial empty ppd test.
TEST(PpdLineReaderTest, Empty) {
  RunTest("", kPpdMaxLineLength, {});
}

// Read kTestPpd contents.
TEST(PpdLineReaderTest, SimplePpd) {
  std::vector<std::string> expected = base::SplitString(
      kTestPpd, "\n", base::KEEP_WHITESPACE, base::SPLIT_WANT_NONEMPTY);
  RunTest(kTestPpd, kPpdMaxLineLength, expected);
}

// Same as SimplePpd test, but with gzipped contents.
TEST(PpdLineReaderTest, SimplePpdGzipped) {
  std::vector<std::string> expected = base::SplitString(
      kTestPpd, "\n", base::KEEP_WHITESPACE, base::SPLIT_WANT_NONEMPTY);
  RunTest(std::string(kTestPpdGzipped, sizeof(kTestPpdGzipped)),
          kPpdMaxLineLength, expected);
}

// Test that we skip lines exceeding max_line_length.
TEST(PpdLineReaderTest, SkipLongLines) {
  // 35 characters is about the median line length in our sample data.
  constexpr int kMaxLineLength = 35;
  std::vector<std::string> expected = base::SplitString(
      kTestPpd, "\n", base::KEEP_WHITESPACE, base::SPLIT_WANT_NONEMPTY);
  base::EraseIf(expected, [](const std::string& entry) -> bool {
    return entry.size() > kMaxLineLength;
  });
  RunTest(kTestPpd, kMaxLineLength, expected);
}

// Same as above, but on gzipped data.
TEST(PpdLineReaderTest, SkipLongLinesGzipped) {
  constexpr int kMaxLineLength = 35;
  std::vector<std::string> expected = base::SplitString(
      kTestPpd, "\n", base::KEEP_WHITESPACE, base::SPLIT_WANT_NONEMPTY);
  base::EraseIf(expected, [](const std::string& entry) -> bool {
    return entry.size() > kMaxLineLength;
  });
  RunTest(std::string(kTestPpdGzipped, sizeof(kTestPpdGzipped)), kMaxLineLength,
          expected);
}

// Test that we get a reasonable error if we try to process corrupt gzip data.
TEST(PpdLineReaderTest, CorruptGzipData) {
  std::string gzipped_contents(kTestPpdGzipped, sizeof(kTestPpdGzipped));
  // Corrupt the contents by zeroing out most of it after the header.

  for (unsigned int i = 50; i < sizeof(kTestPpdGzipped); ++i) {
    gzipped_contents[i] = 0;
  }

  auto reader = PpdLineReader::Create(gzipped_contents, kPpdMaxLineLength);
  // Read as far as we can before the gzip stream gives up.
  std::string unused;

  while (reader->NextLine(&unused)) {
    // Nop.
  }

  // Should have flagged an error because the gzip data was corrupt.
  EXPECT_TRUE(reader->Error());
}

// Tests that the simple PPD begins with the magic number which is present at
// the beginning of all PPD files.
TEST(PpdLineReaderTest, SimplePpdContainsMagicNumber) {
  EXPECT_TRUE(PpdLineReader::ContainsMagicNumber(kTestPpd, kPpdMaxLineLength));
}

// Tests that the Gzipped version of the PPD file begins with the magic number.
TEST(PpdLineReaderTest, GzippedPpdContainsMagicNumber) {
  const std::string gzipped_contents(kTestPpdGzipped, sizeof(kTestPpdGzipped));
  EXPECT_TRUE(
      PpdLineReader::ContainsMagicNumber(gzipped_contents, kPpdMaxLineLength));
}

// Tests that a file which does not begin with the PPD magic number will be
// rejected.
TEST(PpdLineReaderTest, InvalidPpdMagicNumber) {
  EXPECT_FALSE(PpdLineReader::ContainsMagicNumber(
      "*%%%% PPD file for HP PSC 900 Series with CUPS.", kPpdMaxLineLength));

  EXPECT_FALSE(PpdLineReader::ContainsMagicNumber("MZ this is fake exe file",
                                                  kPpdMaxLineLength));
  EXPECT_FALSE(PpdLineReader::ContainsMagicNumber("PK this is a fake zip file",
                                                  kPpdMaxLineLength));
}

// Tests that a file which begins with newline characters should still be
// rejected even if it contains the magic number since it does not appear at the
// beginning of the file.
TEST(PpdLineReaderTest, RejectFileStartingWithNewline) {
  EXPECT_FALSE(PpdLineReader::ContainsMagicNumber("\x0A*PPD-Adobe: \"4.3\"",
                                                  kPpdMaxLineLength));

  EXPECT_FALSE(PpdLineReader::ContainsMagicNumber("\x0D*PPD-Adobe: \"4.3\"",
                                                  kPpdMaxLineLength));
}

}  // namespace
}  // namespace chromeos

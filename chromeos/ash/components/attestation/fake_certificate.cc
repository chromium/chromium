// Copyright 2013 The Chromium Authors
// Use of this source code is governed by a BSD-style license that can be
// found in the LICENSE file.

#ifdef UNSAFE_BUFFERS_BUILD
// TODO(crbug.com/40285824): Remove this and convert code to safer constructs.
#pragma allow_unsafe_buffers
#endif

#include "chromeos/ash/components/attestation/fake_certificate.h"

#include <stdint.h>

#include "base/time/time.h"
#include "crypto/rsa_private_key.h"
#include "net/cert/x509_certificate.h"
#include "net/cert/x509_util.h"

namespace ash {
namespace attestation {

namespace {

// A test key encoded as ASN.1 PrivateKeyInfo from PKCS #8.
const uint8_t kTestKeyData[] = {
    0x30, 0x82, 0x01, 0x55, 0x02, 0x01, 0x00, 0x30, 0x0d, 0x06, 0x09, 0x2a,
    0x86, 0x48, 0x86, 0xf7, 0x0d, 0x01, 0x01, 0x01, 0x05, 0x00, 0x04, 0x82,
    0x01, 0x3f, 0x30, 0x82, 0x01, 0x3b, 0x02, 0x01, 0x00, 0x02, 0x41, 0x00,
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    0x98, 0x68, 0xe1, 0x04, 0xa8, 0x92, 0xd0, 0x10, 0xaa,
};

}  // namespace

bool GetFakeCertificateDER(const base::TimeDelta& expiry,
                           std::string* certificate) {
  base::Time valid_start = base::Time::Now() - base::Days(1);
  base::Time valid_expiry = base::Time::Now() + expiry;
  if (valid_expiry <= valid_start) {
    valid_start = valid_expiry - base::Days(1);
  }
  std::unique_ptr<crypto::RSAPrivateKey> test_key(
      crypto::RSAPrivateKey::CreateFromPrivateKeyInfo(std::vector<uint8_t>(
          &kTestKeyData[0], &kTestKeyData[std::size(kTestKeyData)])));
  if (!test_key.get()) {
    return false;
  }
  return net::x509_util::CreateSelfSignedCert(
      test_key->key(), net::x509_util::DIGEST_SHA256, "CN=subject", 12345,
      valid_start, valid_expiry, {}, certificate);
}

bool GetFakeCertificatePEM(const base::TimeDelta& expiry,
                           std::string* certificate) {
  std::string certificate_der;
  if (!GetFakeCertificateDER(expiry, &certificate_der)) {
    return false;
  }
  return net::X509Certificate::GetPEMEncodedFromDER(certificate_der,
                                                    certificate);
}

}  // namespace attestation
}  // namespace ash

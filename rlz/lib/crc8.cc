// Copyright 2012 The Chromium Authors
// Use of this source code is governed by a BSD-style license that can be
// found in the LICENSE file.

#ifdef UNSAFE_BUFFERS_BUILD
// TODO(crbug.com/351564777): Remove this and convert code to safer constructs.
#pragma allow_unsafe_buffers
#endif

#include "rlz/lib/crc8.h"

namespace {

// The CRC lookup table used for ATM HES (Polynomial = 0x07).
// These are 256 unique 8-bit values.
const unsigned char kCrcTable[256] = {
  0x00, 0x07, 0x0E, 0x09, 0x1C, 0x1B, 0x12, 0x15,
  0x38, 0x3F, 0x36, 0x31, 0x24, 0x23, 0x2A, 0x2D,
  0x70, 0x77, 0x7E, 0x79, 0x6C, 0x6B, 0x62, 0x65,
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  0xE6, 0xE1, 0xE8, 0xEF, 0xFA, 0xFD, 0xF4, 0xF3
};

}  // namespace anonymous


namespace rlz_lib {

bool Crc8::Generate(const unsigned char *data, int length,
                    unsigned char* check_sum) {
  if (!check_sum)
    return false;

  *check_sum = 0;
  if (!data)
    return false;

  // The inital and final constants are as used in the ATM HEC.
  static const unsigned char kInitial = 0x00;
  static const unsigned char kFinal = 0x55;
  unsigned char crc = kInitial;
  for (int i = 0; i < length; ++i) {
    crc = kCrcTable[(data[i] ^ crc) & 0xFFU];
  }

  *check_sum =  crc ^ kFinal;
  return true;
}

bool Crc8::Verify(const unsigned char* data, int length,
                  unsigned char check_sum, bool* matches) {
  if (!matches)
    return false;

  *matches = false;
  if (!data)
    return false;

  unsigned char calculated_crc;
  if (!Generate(data, length, &calculated_crc))
    return false;

  *matches = check_sum == calculated_crc;

  return true;
}

}  // namespace rlz_lib

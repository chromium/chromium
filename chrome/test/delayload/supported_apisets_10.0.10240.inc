// Generated from apisetschema-win10-10240.dll
// FileVersion: 10.0.10240.16384 (th1.150709-1700)
// sha256: 372e090c3f686fa71678bf8faf84fc420515d0411cf933220764b80ceaac870c
{"api-ms-win-appmodel-identity-l1-2", 0},
{"api-ms-win-appmodel-runtime-internal-l1-1", 2},
{"api-ms-win-appmodel-runtime-l1-1", 1},
{"api-ms-win-appmodel-state-l1-1", 2},
{"api-ms-win-appmodel-state-l1-2", 0},
{"api-ms-win-appmodel-unlock-l1-1", 0},
{"api-ms-win-base-bootconfig-l1-1", 0},
{"api-ms-win-base-util-l1-1", 0},
{"api-ms-win-composition-redirection-l1-1", 0},
{"api-ms-win-composition-windowmanager-l1-1", 0},
{"api-ms-win-core-apiquery-l1-1", 0},
{"api-ms-win-core-appcompat-l1-1", 1},
{"api-ms-win-core-appinit-l1-1", 0},
{"api-ms-win-core-atoms-l1-1", 0},
{"api-ms-win-core-bicltapi-l1-1", 3},
{"api-ms-win-core-biplmapi-l1-1", 3},
{"api-ms-win-core-biptcltapi-l1-1", 3},
{"api-ms-win-core-calendar-l1-1", 0},
{"api-ms-win-core-com-l1-1", 1},
{"api-ms-win-core-com-l2-1", 1},
{"api-ms-win-core-com-midlproxystub-l1-1", 0},
{"api-ms-win-core-com-private-l1-1", 1},
{"api-ms-win-core-comm-l1-1", 0},
{"api-ms-win-core-console-ansi-l2-1", 0},
{"api-ms-win-core-console-l1-1", 0},
{"api-ms-win-core-console-l2-1", 0},
{"api-ms-win-core-crt-l1-1", 0},
{"api-ms-win-core-crt-l2-1", 0},
{"api-ms-win-core-datetime-l1-1", 2},
{"api-ms-win-core-debug-l1-1", 2},
{"api-ms-win-core-debug-minidump-l1-1", 0},
{"api-ms-win-core-delayload-l1-1", 1},
{"api-ms-win-core-errorhandling-l1-1", 3},
{"api-ms-win-core-fibers-l1-1", 1},
{"api-ms-win-core-fibers-l2-1", 1},
{"api-ms-win-core-file-ansi-l1-1", 0},
{"api-ms-win-core-file-ansi-l2-1", 0},
{"api-ms-win-core-file-l1-1", 1},
{"api-ms-win-core-file-l1-2", 2},
{"api-ms-win-core-file-l2-1", 2},
{"api-ms-win-core-firmware-l1-1", 0},
{"api-ms-win-core-handle-l1-1", 0},
{"api-ms-win-core-heap-l1-1", 0},
{"api-ms-win-core-heap-l1-2", 0},
{"api-ms-win-core-heap-l2-1", 0},
{"api-ms-win-core-heap-obsolete-l1-1", 0},
{"api-ms-win-core-interlocked-l1-1", 1},
{"api-ms-win-core-interlocked-l1-2", 0},
{"api-ms-win-core-io-l1-1", 1},
{"api-ms-win-core-job-l1-1", 0},
{"api-ms-win-core-job-l2-1", 1},
{"api-ms-win-core-kernel32-legacy-ansi-l1-1", 0},
{"api-ms-win-core-kernel32-legacy-l1-1", 3},
{"api-ms-win-core-kernel32-private-l1-1", 2},
{"api-ms-win-core-largeinteger-l1-1", 0},
{"api-ms-win-core-libraryloader-l1-1", 1},
{"api-ms-win-core-libraryloader-l1-2", 1},
{"api-ms-win-core-libraryloader-l2-1", 0},
{"api-ms-win-core-libraryloader-private-l1-1", 0},
{"api-ms-win-core-localization-ansi-l1-1", 0},
{"api-ms-win-core-localization-l1-1", 0},
{"api-ms-win-core-localization-l1-2", 2},
{"api-ms-win-core-localization-l2-1", 0},
{"api-ms-win-core-localization-obsolete-l1-1", 0},
{"api-ms-win-core-localization-obsolete-l1-2", 0},
{"api-ms-win-core-localization-obsolete-l1-3", 0},
{"api-ms-win-core-localization-private-l1-1", 0},
{"api-ms-win-core-localregistry-l1-1", 0},
{"api-ms-win-core-marshal-l1-1", 0},
{"api-ms-win-core-memory-l1-1", 3},
{"api-ms-win-core-misc-l1-1", 0},
{"api-ms-win-core-multipleproviderrouter-l1-1", 0},
{"api-ms-win-core-namedpipe-ansi-l1-1", 0},
{"api-ms-win-core-namedpipe-l1-1", 0},
{"api-ms-win-core-namedpipe-l1-2", 1},
{"api-ms-win-core-namespace-ansi-l1-1", 0},
{"api-ms-win-core-namespace-l1-1", 0},
{"api-ms-win-core-normalization-l1-1", 0},
{"api-ms-win-core-path-l1-1", 0},
{"api-ms-win-core-perfcounters-l1-1", 0},
{"api-ms-win-core-privateprofile-l1-1", 1},
{"api-ms-win-core-processenvironment-ansi-l1-1", 0},
{"api-ms-win-core-processenvironment-l1-1", 1},
{"api-ms-win-core-processenvironment-l1-2", 0},
{"api-ms-win-core-processsecurity-l1-1", 0},
{"api-ms-win-core-processsnapshot-l1-1", 0},
{"api-ms-win-core-processthreads-l1-1", 3},
{"api-ms-win-core-processtopology-l1-1", 0},
{"api-ms-win-core-processtopology-l1-2", 0},
{"api-ms-win-core-processtopology-obsolete-l1-1", 0},
{"api-ms-win-core-processtopology-private-l1-1", 0},
{"api-ms-win-core-profile-l1-1", 0},
{"api-ms-win-core-psapi-ansi-l1-1", 0},
{"api-ms-win-core-psapi-l1-1", 0},
{"api-ms-win-core-psapi-obsolete-l1-1", 0},
{"api-ms-win-core-psapiansi-l1-1", 0},
{"api-ms-win-core-psm-app-l1-1", 0},
{"api-ms-win-core-psm-appnotify-l1-1", 0},
{"api-ms-win-core-psm-info-l1-1", 0},
{"api-ms-win-core-psm-key-l1-1", 1},
{"api-ms-win-core-psm-plm-l1-1", 3},
{"api-ms-win-core-psm-rtimer-l1-1", 0},
{"api-ms-win-core-psm-tc-l1-1", 1},
{"api-ms-win-core-quirks-l1-1", 1},
{"api-ms-win-core-realtime-l1-1", 1},
{"api-ms-win-core-registry-l1-1", 1},
{"api-ms-win-core-registry-l2-1", 0},
{"api-ms-win-core-registry-l2-2", 0},
{"api-ms-win-core-registry-private-l1-1", 0},
{"api-ms-win-core-registryuserspecific-l1-1", 0},
{"api-ms-win-core-rtlsupport-l1-1", 1},
{"api-ms-win-core-rtlsupport-l1-2", 0},
{"api-ms-win-core-shlwapi-legacy-l1-1", 0},
{"api-ms-win-core-shlwapi-obsolete-l1-1", 0},
{"api-ms-win-core-shlwapi-obsolete-l1-2", 0},
{"api-ms-win-core-shutdown-l1-1", 1},
{"api-ms-win-core-sidebyside-ansi-l1-1", 0},
{"api-ms-win-core-sidebyside-l1-1", 0},
{"api-ms-win-core-slapi-l1-1", 0},
{"api-ms-win-core-string-l1-1", 0},
{"api-ms-win-core-string-l2-1", 1},
{"api-ms-win-core-string-obsolete-l1-1", 1},
{"api-ms-win-core-stringansi-l1-1", 0},
{"api-ms-win-core-stringloader-l1-1", 1},
{"api-ms-win-core-synch-ansi-l1-1", 0},
{"api-ms-win-core-synch-l1-1", 1},
{"api-ms-win-core-synch-l1-2", 1},
{"api-ms-win-core-sysinfo-l1-1", 1},
{"api-ms-win-core-sysinfo-l1-2", 3},
{"api-ms-win-core-sysinfo-l2-1", 0},
{"api-ms-win-core-systemtopology-l1-1", 0},
{"api-ms-win-core-textinput-client-l1-1", 0},
{"api-ms-win-core-threadpool-l1-1", 0},
{"api-ms-win-core-threadpool-l1-2", 0},
{"api-ms-win-core-threadpool-legacy-l1-1", 0},
{"api-ms-win-core-threadpool-private-l1-1", 0},
{"api-ms-win-core-timezone-l1-1", 0},
{"api-ms-win-core-timezone-private-l1-1", 0},
{"api-ms-win-core-toolhelp-l1-1", 0},
{"api-ms-win-core-ums-l1-1", 0},
{"api-ms-win-core-url-l1-1", 0},
{"api-ms-win-core-util-l1-1", 1},
{"api-ms-win-core-version-l1-1", 1},
{"api-ms-win-core-version-private-l1-1", 0},
{"api-ms-win-core-versionansi-l1-1", 1},
{"api-ms-win-core-windowsceip-l1-1", 0},
{"api-ms-win-core-windowserrorreporting-l1-1", 0},
{"api-ms-win-core-winrt-error-l1-1", 1},
{"api-ms-win-core-winrt-errorprivate-l1-1", 1},
{"api-ms-win-core-winrt-l1-1", 0},
{"api-ms-win-core-winrt-propertysetprivate-l1-1", 1},
{"api-ms-win-core-winrt-registration-l1-1", 0},
{"api-ms-win-core-winrt-robuffer-l1-1", 0},
{"api-ms-win-core-winrt-roparameterizediid-l1-1", 0},
{"api-ms-win-core-winrt-string-l1-1", 1},
{"api-ms-win-core-wow64-l1-1", 1},
{"api-ms-win-core-xstate-l1-1", 1},
{"api-ms-win-core-xstate-l2-1", 0},
{"api-ms-win-coremessaging-host-l1-1", 0},
{"api-ms-win-coreui-secruntime-l1-1", 0},
{"api-ms-win-crt-conio-l1-1", 0},
{"api-ms-win-crt-convert-l1-1", 0},
{"api-ms-win-crt-environment-l1-1", 0},
{"api-ms-win-crt-filesystem-l1-1", 0},
{"api-ms-win-crt-heap-l1-1", 0},
{"api-ms-win-crt-locale-l1-1", 0},
{"api-ms-win-crt-math-l1-1", 0},
{"api-ms-win-crt-multibyte-l1-1", 0},
{"api-ms-win-crt-private-l1-1", 0},
{"api-ms-win-crt-process-l1-1", 0},
{"api-ms-win-crt-runtime-l1-1", 0},
{"api-ms-win-crt-stdio-l1-1", 0},
{"api-ms-win-crt-string-l1-1", 0},
{"api-ms-win-crt-time-l1-1", 0},
{"api-ms-win-crt-utility-l1-1", 0},
{"api-ms-win-deprecated-apis-advapi-l1-1", 0},
{"api-ms-win-deprecated-apis-legacy-l1-1", 0},
{"api-ms-win-deprecated-apis-legacy-l1-2", 0},
{"api-ms-win-deprecated-apis-obsolete-l1-1", 0},
{"api-ms-win-devices-config-l1-1", 1},
{"api-ms-win-devices-query-l1-1", 1},
{"api-ms-win-devices-swdevice-l1-1", 1},
{"api-ms-win-downlevel-advapi32-l1-1", 1},
{"api-ms-win-downlevel-advapi32-l2-1", 1},
{"api-ms-win-downlevel-advapi32-l3-1", 0},
{"api-ms-win-downlevel-advapi32-l4-1", 0},
{"api-ms-win-downlevel-kernel32-l1-1", 0},
{"api-ms-win-downlevel-kernel32-l2-1", 0},
{"api-ms-win-downlevel-normaliz-l1-1", 0},
{"api-ms-win-downlevel-ole32-l1-1", 1},
{"api-ms-win-downlevel-shell32-l1-1", 0},
{"api-ms-win-downlevel-shlwapi-l1-1", 1},
{"api-ms-win-downlevel-shlwapi-l2-1", 1},
{"api-ms-win-downlevel-user32-l1-1", 1},
{"api-ms-win-downlevel-version-l1-1", 0},
{"api-ms-win-dwmapi-l1-1", 0},
{"api-ms-win-dx-d3dkmt-l1-1", 1},
{"api-ms-win-eventing-classicprovider-l1-1", 0},
{"api-ms-win-eventing-consumer-l1-1", 0},
{"api-ms-win-eventing-controller-l1-1", 0},
{"api-ms-win-eventing-legacy-l1-1", 0},
{"api-ms-win-eventing-obsolete-l1-1", 0},
{"api-ms-win-eventing-provider-l1-1", 0},
{"api-ms-win-eventlog-legacy-l1-1", 0},
{"api-ms-win-eventlog-private-l1-1", 0},
{"api-ms-win-gaming-tcui-l1-1", 0},
{"api-ms-win-gdi-dpiinfo-l1-1", 0},
{"api-ms-win-http-time-l1-1", 0},
{"api-ms-win-input-ie-interactioncontext-l1-1", 0},
{"api-ms-win-legacy-shlwapi-l1-1", 0},
{"api-ms-win-mm-joystick-l1-1", 0},
{"api-ms-win-mm-mci-l1-1", 0},
{"api-ms-win-mm-misc-l1-1", 1},
{"api-ms-win-mm-misc-l2-1", 0},
{"api-ms-win-mm-mme-l1-1", 0},
{"api-ms-win-mm-playsound-l1-1", 0},
{"api-ms-win-mm-time-l1-1", 0},
{"api-ms-win-net-isolation-l1-1", 1},
{"api-ms-win-networking-interfacecontexts-l1-1", 0},
{"api-ms-win-ntuser-ie-message-l1-1", 0},
{"api-ms-win-ntuser-ie-window-l1-1", 0},
{"api-ms-win-ntuser-ie-wmpointer-l1-1", 0},
{"api-ms-win-ntuser-rectangle-l1-1", 0},
{"api-ms-win-ntuser-sysparams-l1-1", 0},
{"api-ms-win-obsolete-localization-l1-1", 0},
{"api-ms-win-obsolete-psapi-l1-1", 0},
{"api-ms-win-obsolete-shlwapi-l1-1", 0},
{"api-ms-win-ole32-ie-l1-1", 0},
{"api-ms-win-oobe-notification-l1-1", 0},
{"api-ms-win-perf-legacy-l1-1", 0},
{"api-ms-win-power-base-l1-1", 0},
{"api-ms-win-power-limitsmanagement-l1-1", 0},
{"api-ms-win-power-setting-l1-1", 0},
{"api-ms-win-ro-typeresolution-l1-1", 0},
{"api-ms-win-rtcore-minuser-private-l1-1", 1},
{"api-ms-win-rtcore-navigation-l1-1", 0},
{"api-ms-win-rtcore-ntuser-clipboard-l1-1", 0},
{"api-ms-win-rtcore-ntuser-draw-l1-1", 0},
{"api-ms-win-rtcore-ntuser-powermanagement-l1-1", 0},
{"api-ms-win-rtcore-ntuser-private-l1-1", 2},
{"api-ms-win-rtcore-ntuser-shell-l1-1", 0},
{"api-ms-win-rtcore-ntuser-synch-l1-1", 0},
{"api-ms-win-rtcore-ntuser-window-l1-1", 0},
{"api-ms-win-rtcore-ntuser-winevent-l1-1", 0},
{"api-ms-win-rtcore-ntuser-wmpointer-l1-1", 2},
{"api-ms-win-rtcore-ole32-clipboard-l1-1", 0},
{"api-ms-win-rtcore-session-l1-1", 1},
{"api-ms-win-security-accesshlpr-l1-1", 0},
{"api-ms-win-security-activedirectoryclient-l1-1", 1},
{"api-ms-win-security-appcontainer-l1-1", 0},
{"api-ms-win-security-audit-l1-1", 1},
{"api-ms-win-security-base-ansi-l1-1", 0},
{"api-ms-win-security-base-l1-1", 1},
{"api-ms-win-security-base-l1-2", 0},
{"api-ms-win-security-base-private-l1-1", 1},
{"api-ms-win-security-capability-l1-1", 0},
{"api-ms-win-security-cpwl-l1-1", 0},
{"api-ms-win-security-credentials-l1-1", 0},
{"api-ms-win-security-credentials-l2-1", 0},
{"api-ms-win-security-cryptoapi-l1-1", 0},
{"api-ms-win-security-grouppolicy-l1-1", 0},
{"api-ms-win-security-logon-l1-1", 1},
{"api-ms-win-security-lsalookup-ansi-l2-1", 0},
{"api-ms-win-security-lsalookup-l1-1", 2},
{"api-ms-win-security-lsalookup-l2-1", 1},
{"api-ms-win-security-lsapolicy-l1-1", 1},
{"api-ms-win-security-provider-ansi-l1-1", 0},
{"api-ms-win-security-provider-l1-1", 0},
{"api-ms-win-security-sddl-ansi-l1-1", 0},
{"api-ms-win-security-sddl-l1-1", 0},
{"api-ms-win-security-sddlparsecond-l1-1", 0},
{"api-ms-win-security-systemfunctions-l1-1", 0},
{"api-ms-win-security-trustee-l1-1", 1},
{"api-ms-win-service-core-ansi-l1-1", 0},
{"api-ms-win-service-core-l1-1", 2},
{"api-ms-win-service-management-l1-1", 0},
{"api-ms-win-service-management-l2-1", 0},
{"api-ms-win-service-private-l1-1", 1},
{"api-ms-win-service-winsvc-l1-1", 0},
{"api-ms-win-service-winsvc-l1-2", 0},
{"api-ms-win-shcore-comhelpers-l1-1", 0},
{"api-ms-win-shcore-obsolete-l1-1", 0},
{"api-ms-win-shcore-registry-l1-1", 1},
{"api-ms-win-shcore-scaling-l1-1", 2},
{"api-ms-win-shcore-stream-l1-1", 0},
{"api-ms-win-shcore-stream-winrt-l1-1", 0},
{"api-ms-win-shcore-sysinfo-l1-1", 0},
{"api-ms-win-shcore-thread-l1-1", 0},
{"api-ms-win-shcore-unicodeansi-l1-1", 0},
{"api-ms-win-shell-shdirectory-l1-1", 0},
{"api-ms-win-shell-shellcom-l1-1", 0},
{"api-ms-win-shell-shellfolders-l1-1", 0},
{"api-ms-win-shlwapi-ie-l1-1", 0},
{"api-ms-win-shlwapi-winrt-storage-l1-1", 1},
{"api-ms-win-storage-exports-external-l1-1", 0},
{"api-ms-win-storage-exports-internal-l1-1", 0},
{"api-ms-win-winrt-search-folder-l1-1", 0}

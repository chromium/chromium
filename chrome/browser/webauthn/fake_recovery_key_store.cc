// Copyright 2024 The Chromium Authors
// Use of this source code is governed by a BSD-style license that can be
// found in the LICENSE file.

#include "chrome/browser/webauthn/fake_recovery_key_store.h"

#include "base/base64.h"
#include "base/functional/bind.h"
#include "base/functional/callback.h"
#include "base/memory/weak_ptr.h"
#include "base/ranges/algorithm.h"
#include "base/sequence_checker.h"
#include "base/strings/string_number_conversions.h"
#include "base/strings/string_util.h"
#include "components/trusted_vault/proto/recovery_key_store.pb.h"
#include "components/trusted_vault/proto/vault.pb.h"
#include "crypto/sha2.h"
#include "device/fido/enclave/constants.h"
#include "net/cert/x509_util.h"
#include "services/network/public/cpp/data_element.h"
#include "services/network/public/cpp/resource_request.h"
#include "third_party/boringssl/src/include/openssl/bn.h"
#include "third_party/boringssl/src/include/openssl/bytestring.h"
#include "third_party/boringssl/src/include/openssl/ec_key.h"
#include "third_party/boringssl/src/include/openssl/evp.h"
#include "third_party/boringssl/src/include/openssl/rsa.h"

namespace {

// A 2048-bit RSA private key. It matches up with the testing root certificate
// that is embedded in `recovery_key_store.rs`.
static const uint8_t kRootRSAPrivateKey[] = {
    0x30, 0x82, 0x04, 0xa3, 0x02, 0x01, 0x00, 0x02, 0x82, 0x01, 0x01, 0x00,
    0xc7, 0x95, 0x62, 0x74, 0xaf, 0x3f, 0x50, 0xb9, 0xa8, 0x4f, 0x55, 0x12,
    0x0e, 0x5d, 0x1f, 0x89, 0x67, 0xdf, 0x55, 0x8c, 0x16, 0x75, 0x06, 0x1c,
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    0x9d, 0x40, 0x5d,
};

// This is a 2048-bit RSA private key that exists just to avoiding doing
// slow RSA key generation during tests. It can be changed at any time.
static const uint8_t kSigRSAPrivateKey[] = {
    0x30, 0x82, 0x04, 0xa3, 0x02, 0x01, 0x00, 0x02, 0x82, 0x01, 0x01, 0x00,
    0xc2, 0xce, 0x06, 0x23, 0xc3, 0x04, 0x5d, 0xe4, 0x6d, 0x03, 0x82, 0x2c,
    0x3a, 0x7f, 0x8d, 0xef, 0x94, 0xa9, 0x26, 0xca, 0x0e, 0x5f, 0xca, 0xbf,
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    0x45, 0xc2, 0xc4,
};

// kTestTime is the fake time at which the test enclave service runs at.
// This value also appears in
// //third_party/cloud_authenticator/test/local_service/src/main.rs.
constexpr uint32_t kTestTime = 1707344402;

// Load an RSA private key from one of the embedded bytestrings, above.
bssl::UniquePtr<EVP_PKEY> GetRSAKey(base::span<const uint8_t> der) {
  CBS cbs;
  CBS_init(&cbs, der.data(), der.size());
  bssl::UniquePtr<RSA> rsa(RSA_parse_private_key(&cbs));
  CHECK(rsa);
  bssl::UniquePtr<EVP_PKEY> pkey(EVP_PKEY_new());
  EVP_PKEY_set1_RSA(pkey.get(), rsa.get());
  return pkey;
}

// Generate a random P-256 key.
bssl::UniquePtr<EVP_PKEY> NewECKey() {
  bssl::UniquePtr<EC_KEY> ec_key(
      EC_KEY_new_by_curve_name(NID_X9_62_prime256v1));
  CHECK(EC_KEY_generate_key(ec_key.get()));
  bssl::UniquePtr<EVP_PKEY> pkey(EVP_PKEY_new());
  EVP_PKEY_set1_EC_KEY(pkey.get(), ec_key.get());
  return pkey;
}

class FakeRecoveryKeyStoreImpl : public FakeRecoveryKeyStore {
 public:
  explicit FakeRecoveryKeyStoreImpl()
      : root_key_(GetRSAKey(kRootRSAPrivateKey)),
        sig_key_(GetRSAKey(kSigRSAPrivateKey)),
        endpoint_key_(NewECKey()) {
    // To avoid expiration issues, the test enclave runs at a fixed time
    // (`kTestTime`). Certificates are generated to be valid for a week before
    // and after that point.
    const base::Time not_before = base::Time::FromTimeT(kTestTime - 7 * 86400);
    const base::Time not_after = base::Time::FromTimeT(kTestTime + 7 * 86400);

    // This code was used to generate the root certificate that is included
    // in `recovery_key_store.rs`.
#if 0
    static const uint8_t kBasicConstraints[] = {0x55, 0x1d, 0x13};
    static const uint8_t kIsCA[] = {0x30, 0x03, 0x01, 0x01, 0xff};
    std::string root_cert;
    CHECK(net::x509_util::CreateSelfSignedCert(
        endpoint_key_.get(), net::x509_util::DIGEST_SHA256, "CN=Root",
        /*serial_number=*/1, not_before, not_after,
        {net::x509_util::Extension(kBasicConstraints, /*critical=*/true,
                                   kIsCA)},
        &root_cert));
    const std::string root_cert_hex = base::HexEncode(root_cert);
    write(1, root_cert_hex.data(), root_cert_hex.size());
    write(1, "\n", 1);
#endif

    CHECK(net::x509_util::CreateCert(
        sig_key_.get(), net::x509_util::DIGEST_SHA256, "CN=Sig",
        /*serial_number=*/2, not_before, not_after, /*extension_specs=*/{},
        "CN=Root", root_key_.get(), &sig_cert_der_));
    CHECK(net::x509_util::CreateCert(
        endpoint_key_.get(), net::x509_util::DIGEST_SHA256, "CN=Endpoint",
        /*serial_number=*/3, not_before, not_after, /*extension_specs=*/{},
        "CN=Root", root_key_.get(), &endpoint_cert_der_));

    certs_xml_ = base::ReplaceStringPlaceholders(
        R"(<?xml version="1.0" encoding="UTF-8"?>
<certificate>
  <metadata>
    <serial>2</serial>
    <creation-time>$1</creation-time>
    <refresh-interval>2592000</refresh-interval>
    <previous>
      <serial>1</serial>
      <hash>TQudrujnu1I9bdoDaYxGQYuRN/8SwTLjdk6vzYTOkIU=</hash>
    </previous>
  </metadata>
  <intermediates>
  </intermediates>
  <endpoints>
    <cert>$2</cert>
  </endpoints>
</certificate>
)",
        {base::NumberToString(kTestTime),
         base::Base64Encode(endpoint_cert_der_)},
        /*offsets=*/nullptr);

    const auto certs_xml_hash =
        crypto::SHA256Hash(base::as_bytes(base::make_span(certs_xml_)));
    RSA* const sig_key = EVP_PKEY_get0_RSA(sig_key_.get());
    unsigned sig_len = RSA_size(sig_key);
    std::vector<uint8_t> sig(sig_len, 0);
    CHECK(RSA_sign(NID_sha256, certs_xml_hash.data(), certs_xml_hash.size(),
                   sig.data(), &sig_len, sig_key));

    sig_xml_ = base::ReplaceStringPlaceholders(
        R"(<?xml version="1.0" encoding="UTF-8"?>
<signature>
  <chromium-test>true</chromium-test>
  <intermediates>
  </intermediates>
  <certificate>$1</certificate>
  <value>$2</value>
</signature>
)",
        {base::Base64Encode(sig_cert_der_), base::Base64Encode(sig)},
        /*offsets=*/nullptr);
  }

  ~FakeRecoveryKeyStoreImpl() override = default;

  base::RepeatingCallback<MaybeResponse(const network::ResourceRequest&)>
  GetCallback() override {
    DCHECK_CALLED_ON_VALID_SEQUENCE(sequence_checker_);

    return base::BindRepeating(
        [](base::WeakPtr<FakeRecoveryKeyStoreImpl> impl,
           const network::ResourceRequest& request) -> MaybeResponse {
          // Passing a WeakPtr into BindRepeating is only supported if the
          // function returns void. Thus the WeakPtr is handled directly here.
          if (!impl) {
            return std::nullopt;
          }
          return impl->OnRequest(request);
        },
        weak_ptr_factory_.GetWeakPtr());
  }

  base::span<const trusted_vault_pb::Vault> vaults() const override {
    return vaults_;
  }

  void break_cert_xml_file() override { break_cert_xml_file_ = true; }

  void break_sig_xml_file() override { break_sig_xml_file_ = true; }

  std::array<uint8_t, 32> endpoint_private_key_bytes() const override {
    std::array<uint8_t, 32> result;
    CHECK(BN_bn2bin_padded(
        result.data(), result.size(),
        EC_KEY_get0_private_key(EVP_PKEY_get0_EC_KEY(endpoint_key_.get()))));
    return result;
  }

 private:
  MaybeResponse OnRequest(const network::ResourceRequest& request) {
    DCHECK_CALLED_ON_VALID_SEQUENCE(sequence_checker_);

    if (request.url == device::enclave::kRecoveryKeyStoreCertFileURL) {
      if (break_cert_xml_file_) {
        return std::make_pair(net::HTTP_NOT_FOUND, "");
      }
      return std::make_pair(net::HTTP_OK, certs_xml_);
    }

    if (request.url == device::enclave::kRecoveryKeyStoreSigFileURL) {
      if (break_sig_xml_file_) {
        return std::make_pair(net::HTTP_NOT_FOUND, "");
      }
      return std::make_pair(net::HTTP_OK, sig_xml_);
    }

    if (request.url ==
        std::string(device::enclave::kRecoveryKeyStoreURL) + "?alt=proto") {
      return ProcessVaultUpdate(request);
    }

    return std::nullopt;
  }

  MaybeResponse ProcessVaultUpdate(
      const network::ResourceRequest& resource_request) {
    const std::vector<network::DataElement>* const elements =
        resource_request.request_body->elements();
    CHECK_EQ(elements->size(), 1u);
    CHECK_EQ(elements->at(0).type(), network::DataElement::Tag::kBytes);
    const std::string_view body =
        elements->at(0).As<network::DataElementBytes>().AsStringPiece();

    trusted_vault_pb::Vault request;
    CHECK(request.ParseFromArray(body.data(), body.size()));
    CHECK(!request.vault_parameters().vault_handle().empty());
    CHECK_EQ(request.vault_parameters().vault_handle()[0], 3 /* GPM PIN */);
    auto existing = base::ranges::find_if(
        vaults_, [&request](const auto& candidate) -> bool {
          const auto& candidate_params = candidate.vault_parameters();
          const auto& request_params = request.vault_parameters();
          return candidate_params.backend_public_key() ==
                     request_params.backend_public_key() &&
                 candidate_params.counter_id() == request_params.counter_id() &&
                 candidate_params.vault_handle() ==
                     request_params.vault_handle();
        });
    if (existing != vaults_.end()) {
      *existing = std::move(request);
    } else {
      vaults_.emplace_back(std::move(request));
    }

    trusted_vault_pb::Vault response;
    response.mutable_vault_parameters()->set_vault_handle("test vault handle");
    return std::make_pair(net::HTTP_OK, response.SerializeAsString());
  }

  const bssl::UniquePtr<EVP_PKEY> root_key_;
  const bssl::UniquePtr<EVP_PKEY> sig_key_;
  const bssl::UniquePtr<EVP_PKEY> endpoint_key_;
  std::string sig_cert_der_;
  std::string endpoint_cert_der_;
  std::string certs_xml_;
  std::string sig_xml_;
  std::vector<trusted_vault_pb::Vault> vaults_;
  bool break_cert_xml_file_ = false;
  bool break_sig_xml_file_ = false;
  SEQUENCE_CHECKER(sequence_checker_);
  base::WeakPtrFactory<FakeRecoveryKeyStoreImpl> weak_ptr_factory_{this};
};

}  // namespace

FakeRecoveryKeyStore::~FakeRecoveryKeyStore() = default;

// static
std::unique_ptr<FakeRecoveryKeyStore> FakeRecoveryKeyStore::New() {
  return std::make_unique<FakeRecoveryKeyStoreImpl>();
}

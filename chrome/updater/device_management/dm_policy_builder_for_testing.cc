// Copyright 2020 The Chromium Authors
// Use of this source code is governed by a BSD-style license that can be
// found in the LICENSE file.

#include "chrome/updater/device_management/dm_policy_builder_for_testing.h"

#include <stdint.h>

#include <memory>
#include <string>
#include <utility>

#include "base/logging.h"
#include "base/time/time.h"
#include "chrome/updater/protos/omaha_settings.pb.h"
#include "chrome/updater/test/unit_test_util.h"
#include "components/policy/proto/device_management_backend.pb.h"
#include "crypto/rsa_private_key.h"
#include "crypto/signature_creator.h"

namespace updater {

namespace {

// A test signing key raw bytes in DER-encoded PKCS8 format.
const uint8_t kSigningKey1[] = {
    0x30, 0x82, 0x01, 0x55, 0x02, 0x01, 0x00, 0x30, 0x0d, 0x06, 0x09, 0x2a,
    0x86, 0x48, 0x86, 0xf7, 0x0d, 0x01, 0x01, 0x01, 0x05, 0x00, 0x04, 0x82,
    0x01, 0x3f, 0x30, 0x82, 0x01, 0x3b, 0x02, 0x01, 0x00, 0x02, 0x41, 0x00,
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    0x98, 0x68, 0xe1, 0x04, 0xa8, 0x92, 0xd0, 0x10, 0xaa,
};

// SHA256 signature of kSigningKey for "example.com" domain.
const uint8_t kSigningKey1Signature[] = {
    0x97, 0xEB, 0x13, 0xE6, 0x6C, 0xE2, 0x7A, 0x2F, 0xC6, 0x6E, 0x68, 0x8F,
    0xED, 0x5B, 0x51, 0x08, 0x27, 0xF0, 0xA5, 0x97, 0x20, 0xEE, 0xE2, 0x9B,
    0x5B, 0x63, 0xA5, 0x9C, 0xAE, 0x41, 0xFD, 0x34, 0xC4, 0x2E, 0xEB, 0x63,
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    0x9A, 0x80, 0x3F, 0x76,
};

// Another (new) test signing key raw bytes in DER-encoded PKCS8 format.
const uint8_t kSigningKey2[] = {
    0x30, 0x82, 0x01, 0x54, 0x02, 0x01, 0x00, 0x30, 0x0d, 0x06, 0x09, 0x2a,
    0x86, 0x48, 0x86, 0xf7, 0x0d, 0x01, 0x01, 0x01, 0x05, 0x00, 0x04, 0x82,
    0x01, 0x3e, 0x30, 0x82, 0x01, 0x3a, 0x02, 0x01, 0x00, 0x02, 0x41, 0x00,
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    0x32, 0x1a, 0x6b, 0xb3, 0x5f, 0x35, 0xbd, 0xf3,
};

// SHA256 signature of kSigningKey2 for "example.com" domain.
const uint8_t kSigningKey2Signature[] = {
    0x70, 0xED, 0x27, 0x42, 0x34, 0x69, 0xB6, 0x47, 0x9E, 0x7C, 0xA0, 0xF0,
    0xE5, 0x0A, 0x49, 0x49, 0x00, 0xDA, 0xBC, 0x70, 0x01, 0xC5, 0x4B, 0xDB,
    0x47, 0xD5, 0xAF, 0xA1, 0xAD, 0xB7, 0xE4, 0xE1, 0xBD, 0x5A, 0x1C, 0x35,
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    0xDD, 0x6F, 0x80, 0xC3,
};

}  // namespace

std::unique_ptr<DMSigningKeyForTesting> GetTestKey1() {
  constexpr int kFakeKeyVersion = 5;
  return std::make_unique<DMSigningKeyForTesting>(
      kSigningKey1, sizeof(kSigningKey1), kSigningKey1Signature,
      sizeof(kSigningKey1Signature), kFakeKeyVersion, "example.com");
}

std::unique_ptr<DMSigningKeyForTesting> GetTestKey2() {
  constexpr int kFakeKeyVersion = 7;
  return std::make_unique<DMSigningKeyForTesting>(
      kSigningKey2, sizeof(kSigningKey2), kSigningKey2Signature,
      sizeof(kSigningKey2Signature), kFakeKeyVersion, "example.com");
}

std::unique_ptr<
    ::wireless_android_enterprise_devicemanagement::OmahaSettingsClientProto>
GetDefaultTestingOmahaPolicyProto() {
  auto omaha_settings =
      std::make_unique<::wireless_android_enterprise_devicemanagement::
                           OmahaSettingsClientProto>();

  omaha_settings->set_auto_update_check_period_minutes(111);
  omaha_settings->mutable_updates_suppressed()->set_start_hour(9);
  omaha_settings->mutable_updates_suppressed()->set_start_minute(30);
  omaha_settings->mutable_updates_suppressed()->set_duration_min(120);
  omaha_settings->set_download_preference("cacheable");
  omaha_settings->set_proxy_mode("pac_script");
  omaha_settings->set_proxy_pac_url("foo.c/proxy.pa");
  omaha_settings->set_install_default(
      ::wireless_android_enterprise_devicemanagement::INSTALL_DEFAULT_ENABLED);
  omaha_settings->set_update_default(
      ::wireless_android_enterprise_devicemanagement::MANUAL_UPDATES_ONLY);

  ::wireless_android_enterprise_devicemanagement::ApplicationSettings app;
  app.set_app_guid(test::kChromeAppId);
  app.set_install(
      ::wireless_android_enterprise_devicemanagement::INSTALL_DISABLED);
  app.set_update(
      ::wireless_android_enterprise_devicemanagement::AUTOMATIC_UPDATES_ONLY);
  app.set_target_version_prefix("81.");
  app.set_rollback_to_target_version(
      ::wireless_android_enterprise_devicemanagement::
          ROLLBACK_TO_TARGET_VERSION_ENABLED);
  app.set_target_channel("beta");
  omaha_settings->mutable_application_settings()->Add(std::move(app));

  return omaha_settings;
}

std::unique_ptr<::enterprise_management::DeviceManagementResponse>
GetDMResponseForOmahaPolicy(
    bool first_request,
    bool rotate_to_new_key,
    DMPolicyBuilderForTesting::SigningOption signing_option,
    const std::string& dm_token,
    const std::string& device_id,
    const ::wireless_android_enterprise_devicemanagement::
        OmahaSettingsClientProto& omaha_settings) {
  return DMPolicyBuilderForTesting::CreateInstanceWithOptions(
             first_request, rotate_to_new_key, signing_option, dm_token,
             device_id)
      ->BuildDMResponseForPolicies(
          {{"google/machine-level-omaha", omaha_settings.SerializeAsString()}});
}

std::unique_ptr<::enterprise_management::DeviceManagementResponse>
GetDefaultTestingPolicyFetchDMResponse(
    bool first_request,
    bool rotate_to_new_key,
    DMPolicyBuilderForTesting::SigningOption signing_option) {
  return GetDMResponseForOmahaPolicy(
      first_request, rotate_to_new_key, signing_option, "test-dm-token",
      "test-device-id", *GetDefaultTestingOmahaPolicyProto());
}

DMSigningKeyForTesting::DMSigningKeyForTesting(const uint8_t key_data[],
                                               size_t key_data_length,
                                               const uint8_t key_signature[],
                                               size_t key_signature_length,
                                               int key_version,
                                               const std::string& domain)
    : key_data_(key_data, key_data + key_data_length),
      key_signature_(reinterpret_cast<const char*>(key_signature),
                     key_signature_length),
      key_version_(key_version),
      key_signature_domain_(domain) {}

DMSigningKeyForTesting::~DMSigningKeyForTesting() = default;

std::string DMSigningKeyForTesting::GetPublicKeyString() const {
  std::vector<uint8_t> public_key;
  std::unique_ptr<crypto::RSAPrivateKey> private_key =
      crypto::RSAPrivateKey::CreateFromPrivateKeyInfo(key_data_);
  private_key->ExportPublicKey(&public_key);
  return std::string(reinterpret_cast<const char*>(public_key.data()),
                     public_key.size());
}

void DMSigningKeyForTesting::SignData(const std::string& data,
                                      std::string* signature) const {
  std::unique_ptr<crypto::RSAPrivateKey> private_key =
      crypto::RSAPrivateKey::CreateFromPrivateKeyInfo(key_data_);
  std::unique_ptr<crypto::SignatureCreator> signature_creator(
      crypto::SignatureCreator::Create(private_key.get(),
                                       crypto::SignatureCreator::SHA256));
  signature_creator->Update(reinterpret_cast<const uint8_t*>(data.c_str()),
                            data.size());
  std::vector<uint8_t> signature_bytes;
  signature_creator->Final(&signature_bytes);

  signature->assign(reinterpret_cast<const char*>(signature_bytes.data()),
                    signature_bytes.size());
}

DMPolicyBuilderForTesting::DMPolicyBuilderForTesting(
    const std::string& dm_token,
    const std::string& user_name,
    const std::string& device_id,
    std::unique_ptr<DMSigningKeyForTesting> signing_key,
    std::unique_ptr<DMSigningKeyForTesting> new_signing_key,
    SigningOption signing_option)
    : dm_token_(dm_token),
      user_name_(user_name),
      device_id_(device_id),
      signing_option_(signing_option),
      signing_key_(std::move(signing_key)),
      new_signing_key_(std::move(new_signing_key)) {}

DMPolicyBuilderForTesting::~DMPolicyBuilderForTesting() = default;

// static
std::unique_ptr<DMPolicyBuilderForTesting>
DMPolicyBuilderForTesting::CreateInstanceWithOptions(
    bool first_request,
    bool rotate_to_new_key,
    SigningOption signing_option,
    const std::string& dm_token,
    const std::string& device_id) {
  std::unique_ptr<DMSigningKeyForTesting> signing_key;
  std::unique_ptr<DMSigningKeyForTesting> new_signing_key;

  if (first_request) {
    new_signing_key = GetTestKey1();
  } else {
    signing_key = GetTestKey1();
    if (rotate_to_new_key) {
      new_signing_key = GetTestKey2();
    }
  }

  return std::make_unique<DMPolicyBuilderForTesting>(
      dm_token, "username@example.com", device_id, std::move(signing_key),
      std::move(new_signing_key), signing_option);
}

void DMPolicyBuilderForTesting::FillPolicyFetchResponseWithPayload(
    enterprise_management::PolicyFetchResponse* policy_response,
    const std::string& policy_type,
    const std::string& policy_payload,
    bool attach_new_public_key) const {
  const DMSigningKeyForTesting* signing_key = signing_key_.get();
  if (new_signing_key_ && attach_new_public_key) {
    VLOG(1) << "Attaching new public key for policy " << policy_type;
    signing_key = new_signing_key_.get();

    // Attach the new public key and its signature to the policy response.
    std::string new_public_key_string = new_signing_key_->GetPublicKeyString();
    policy_response->set_new_public_key(new_public_key_string);
    policy_response->set_new_public_key_verification_signature_deprecated(
        new_signing_key_->GetPublicKeySignature());
    if (signing_key_) {
      if (signing_option_ == SigningOption::kTamperKeySignature) {
        *policy_response->mutable_new_public_key_signature() = "bad-key-sig";
      } else {
        policy_response->set_policy_data_signature_type(
            enterprise_management::PolicyFetchRequest::SHA256_RSA);
        signing_key_->SignData(
            policy_response->new_public_key(),
            policy_response->mutable_new_public_key_signature());
      }
    }

    // Attach the new public key verification data to policy response.
    enterprise_management::PublicKeyVerificationData key_verif_data;
    key_verif_data.set_new_public_key(new_public_key_string);
    key_verif_data.set_domain(new_signing_key_->GetPublicKeySignatureDomain());

    policy_response->set_new_public_key_verification_data(
        key_verif_data.SerializeAsString());
    policy_response->set_new_public_key_verification_data_signature(
        new_signing_key_->GetPublicKeySignature());
  } else {
    VLOG(1) << "Added policy [" << policy_type
            << "] in response without a public key.";
    policy_response->clear_new_public_key();
    policy_response->clear_new_public_key_verification_data();
    policy_response->clear_new_public_key_verification_data_signature();
    policy_response->clear_new_public_key_verification_signature_deprecated();
  }

  enterprise_management::PolicyData policy_data;
  policy_data.set_policy_type(policy_type);
  policy_data.set_timestamp(
      (base::Time::Now() - base::Time::UnixEpoch()).InMilliseconds());
  policy_data.set_request_token(dm_token_);
  if (signing_key->has_key_version()) {
    policy_data.set_public_key_version(signing_key->key_version());
  }
  policy_data.set_username(user_name_);
  policy_data.set_device_id(device_id_);
  policy_data.set_policy_value(policy_payload);
  policy_data.SerializeToString(policy_response->mutable_policy_data());

  // PolicyData signature.
  if (signing_option_ == SigningOption::kTamperDataSignature) {
    *policy_response->mutable_policy_data_signature() = "bad-data-sig";
  } else {
    policy_response->set_policy_data_signature_type(
        enterprise_management::PolicyFetchRequest::SHA256_RSA);
    signing_key->SignData(policy_response->policy_data(),
                          policy_response->mutable_policy_data_signature());
  }
}

std::string DMPolicyBuilderForTesting::GetResponseBlobForPolicyPayload(
    const std::string& policy_type,
    const std::string& policy_payload) const {
  enterprise_management::PolicyFetchResponse policy_response;
  FillPolicyFetchResponseWithPayload(&policy_response, policy_type,
                                     policy_payload,
                                     /*attach_new_public_key=*/true);
  return policy_response.SerializeAsString();
}

std::unique_ptr<::enterprise_management::DeviceManagementResponse>
DMPolicyBuilderForTesting::BuildDMResponseForPolicies(
    const base::flat_map<std::string, std::string>& policies) const {
  auto dm_response =
      std::make_unique<::enterprise_management::DeviceManagementResponse>();

  for (const auto& [policy_type, policy_data] : policies) {
    FillPolicyFetchResponseWithPayload(
        dm_response->mutable_policy_response()->add_responses(), policy_type,
        policy_data,
        /*attach_new_public_key=*/policy_type == "google/machine-level-omaha");
  }
  return dm_response;
}

std::unique_ptr<::enterprise_management::DeviceManagementResponse>
DMPolicyBuilderForTesting::BuildDMResponseWithError(
    ::enterprise_management::DeviceManagementErrorDetail error) const {
  auto dm_response =
      std::make_unique<::enterprise_management::DeviceManagementResponse>();
  dm_response->add_error_detail(error);
  return dm_response;
}

}  // namespace updater
